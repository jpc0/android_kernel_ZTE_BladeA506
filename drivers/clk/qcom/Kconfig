## drivers/clk/qcom/Kconfig
```kconfig
config MSM_CLK_CONTROLLER_V2
	bool "QTI clock driver"
	---help---
	   Generate clock data structures from definitions found in
	   device tree.
config LCDBL_GPIO_PWM
	bool "LCD pwm gpio"
	---help---
	   Generate gpio pwm.
source "drivers/clk/qcom/mdss/Kconfig"
```
